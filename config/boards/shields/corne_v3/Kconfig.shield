## config/boards/shields/corne_v3/Kconfig.shield
```kconfig
# Copyright (c) 2020 Pete Johanson
# SPDX-License-Identifier: MIT

config SHIELD_CORNE_V3_LEFT
	def_bool $(shields_list_contains,corne_v3_left) || $(shields_list_contains,corne_v3_left_bare)

config SHIELD_CORNE_V3_RIGHT
	def_bool $(shields_list_contains,corne_v3_right) || $(shields_list_contains,corne_v3_right_bare) || $(shields_list_contains,corne_v3_right_nobtn)
```

## config/west.yml
```yaml
manifest:
  remotes:
    - name: zmkfirmware
      url-base: https://github.com/zmkfirmware
  projects:
    - name: zmk
      remote: zmkfirmware
      # ZMK main tracks Zephyr 4.x (PAT912x native input driver)
      revision: main
      import: app/west.yml
  self:
    path: config
```

## dts/bindings/behaviors/corne,behavior-batt-bar.yaml
```yaml
# Copyright (c) 2026 The ZMK Contributors
# SPDX-License-Identifier: MIT

description: |
  Briefly show this half's battery level as a green bar on the Corne
  middle per-key LED row (indices fixed in batt_bar.c from foostan/QMK map).

compatible: "corne,behavior-batt-bar"

include: zero_param.yaml

properties:
  hold-ms:
    type: int
    default: 2500
    description: How long to keep the bar visible.
```

## dts/bindings/behaviors/corne,behavior-status-sync.yaml
```yaml
# Copyright (c) 2026 The ZMK Contributors
# SPDX-License-Identifier: MIT

description: |
  Relay central layer/output status to the split peripheral for OLED.

compatible: "corne,behavior-status-sync"

include: one_param.yaml
```

## dts/bindings/input/corne,pat912x-poll.yaml
```yaml
# Copyright (c) 2026 The ZMK Contributors
# SPDX-License-Identifier: MIT

description: |
  PAT9125EL trackball with Prusa/PixArt full init + software polling.
  MOTION GPIO is not used.

compatible: "corne,pat912x-poll"

include: i2c-device.yaml

properties:
  poll-interval-ms:
    type: int
    default: 5

  zephyr,axis-x:
    type: int

  zephyr,axis-y:
    type: int

  res-x:
    type: int
    default: 0xbc
    description: Raw RES_X register (0xBC ≈ 1000 CPI).

  res-y:
    type: int
    default: 0xbc
    description: Raw RES_Y register (0xBC ≈ 1000 CPI).

  invert-x:
    type: boolean

  invert-y:
    type: boolean

  ignore-product-id:
    type: boolean
```

## dts/bindings/misc/corne,led-strip-blank-prefix.yaml
```yaml
# Copyright (c) 2026 The ZMK Contributors
# SPDX-License-Identifier: MIT

description: |
  LED strip proxy that forces the first N pixels off (Corne underglow),
  then forwards the frame to the real WS2812 strip.

compatible: "corne,led-strip-blank-prefix"

properties:
  target:
    type: phandle
    required: true
    description: Real LED strip device to forward updates to.

  chain-length:
    type: int
    required: true
    description: Total pixels (must match the target strip).

  blank-count:
    type: int
    default: 6
    description: How many leading pixels to force off every frame.
```

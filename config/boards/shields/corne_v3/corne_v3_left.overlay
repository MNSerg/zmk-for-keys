/*
 * Copyright (c) 2020 Pete Johanson
 *
 * SPDX-License-Identifier: MIT
 */

#include "corne_v3.dtsi"
#include <input/processors.dtsi>
#include <dt-bindings/zmk/input_transform.h>
#include "trackball_tuning.h"

&kscan0 {
	col-gpios
		= <&pro_micro 21 GPIO_ACTIVE_HIGH>
		, <&pro_micro 20 GPIO_ACTIVE_HIGH>
		, <&pro_micro 19 GPIO_ACTIVE_HIGH>
		, <&pro_micro 18 GPIO_ACTIVE_HIGH>
		, <&pro_micro 15 GPIO_ACTIVE_HIGH>
		, <&pro_micro 14 GPIO_ACTIVE_HIGH>
		;
};

/* Give EXT_POWER time before OLED/RGB on VCC come up */
&{/EXT_POWER} {
	init-delay-ms = <200>;
};

/*
 * Trackball on central (events from right).
 * Tunables: trackball_tuning.h — see docs/05-trackball.md
 */
&trackball_listener {
	status = "okay";
	input-processors
		= <&zip_xy_transform CORNE_MOUSE_TRANSFORM>
		, <&zip_xy_scaler CORNE_MOUSE_SCALE_MUL CORNE_MOUSE_SCALE_DIV>
		;

	scroll {
		layers = <2>;
		input-processors
			= <&zip_xy_transform CORNE_SCROLL_TRANSFORM>
			, <&zip_xy_scaler CORNE_SCROLL_SCALE_MUL CORNE_SCROLL_SCALE_DIV>
			, <&zip_xy_to_scroll_mapper>
			;
	};
};
